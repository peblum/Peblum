## boards/obelix/Kconfig.defconfig
```kconfig
# SPDX-FileCopyrightText: 2026 Core Devices LLC
# SPDX-License-Identifier: Apache-2.0

config IDLE_POWER_SAVER
    default y if SERVICE_STATIONARY

config IDLE_POWER_SAVER_DEFAULT_ON
    default y if IDLE_POWER_SAVER
```

## src/fw/services/stationary/Kconfig
```kconfig
# SPDX-FileCopyrightText: 2026 Core Devices LLC
# SPDX-License-Identifier: Apache-2.0

config SERVICE_STATIONARY
    bool "Stationary"
    help
      Stationary (idle-detection) service.

config IDLE_POWER_SAVER
    bool "Idle Power Saver setting"
    depends on SERVICE_STATIONARY
    help
      Offer an Idle Power Saver setting. With it on, a watch left lying
      still off the charger enters low power mode instead of the lighter
      stand-by mode, and pressing SELECT on the low power watchface wakes
      it again.

config IDLE_POWER_SAVER_DEFAULT_ON
    bool "Idle Power Saver on by default"
    depends on IDLE_POWER_SAVER
    help
      Start with the Idle Power Saver setting on until the user changes it.

if SERVICE_STATIONARY

module = SERVICE_STATIONARY
module-str = Stationary
source "subsys/logging/Kconfig.template.log_level"

endif
```
